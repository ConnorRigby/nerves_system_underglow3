&ledc {
	multi-led@0 {
		label = "pixel_0";
		reg = <0x0>;
		color = <LED_COLOR_ID_RGB>;
		function = LED_FUNCTION_STATUS;
	};

	multi-led@1 {
		label = "pixel_1";
		reg = <0x1>;
		color = <LED_COLOR_ID_RGB>;
		function = LED_FUNCTION_STATUS;
	};

	multi-led@2 {
		label = "pixel_2";
		reg = <0x2>;
		color = <LED_COLOR_ID_RGB>;
		function = LED_FUNCTION_STATUS;
	};

	multi-led@3 {
		label = "pixel_3";
		reg = <0x3>;
		color = <LED_COLOR_ID_RGB>;
		function = LED_FUNCTION_STATUS;
	};

	multi-led@4 {
		label = "pixel_4";
		reg = <0x4>;
		color = <LED_COLOR_ID_RGB>;
		function = LED_FUNCTION_STATUS;
	};

	multi-led@5 {
		label = "pixel_5";
		reg = <0x5>;
		color = <LED_COLOR_ID_RGB>;
		function = LED_FUNCTION_STATUS;
	};

	multi-led@6 {
		label = "pixel_6";
		reg = <0x6>;
		color = <LED_COLOR_ID_RGB>;
		function = LED_FUNCTION_STATUS;
	};

	multi-led@7 {
		label = "pixel_7";
		reg = <0x7>;
		color = <LED_COLOR_ID_RGB>;
		function = LED_FUNCTION_STATUS;
	};

	multi-led@8 {
		label = "pixel_8";
		reg = <0x8>;
		color = <LED_COLOR_ID_RGB>;
		function = LED_FUNCTION_STATUS;
	};

	multi-led@9 {
		label = "pixel_9";
		reg = <0x9>;
		color = <LED_COLOR_ID_RGB>;
		function = LED_FUNCTION_STATUS;
	};

	multi-led@A {
		label = "pixel_10";
		reg = <0xA>;
		color = <LED_COLOR_ID_RGB>;
		function = LED_FUNCTION_STATUS;
	};

	multi-led@B {
		label = "pixel_11";
		reg = <0xB>;
		color = <LED_COLOR_ID_RGB>;
		function = LED_FUNCTION_STATUS;
	};

	multi-led@C {
		label = "pixel_12";
		reg = <0xC>;
		color = <LED_COLOR_ID_RGB>;
		function = LED_FUNCTION_STATUS;
	};

	multi-led@D {
		label = "pixel_13";
		reg = <0xD>;
		color = <LED_COLOR_ID_RGB>;
		function = LED_FUNCTION_STATUS;
	};

	multi-led@E {
		label = "pixel_14";
		reg = <0xE>;
		color = <LED_COLOR_ID_RGB>;
		function = LED_FUNCTION_STATUS;
	};

	multi-led@F {
		label = "pixel_15";
		reg = <0xF>;
		color = <LED_COLOR_ID_RGB>;
		function = LED_FUNCTION_STATUS;
	};

	multi-led@10 {
		label = "pixel_16";
		reg = <0x10>;
		color = <LED_COLOR_ID_RGB>;
		function = LED_FUNCTION_STATUS;
	};

	multi-led@11 {
		label = "pixel_17";
		reg = <0x11>;
		color = <LED_COLOR_ID_RGB>;
		function = LED_FUNCTION_STATUS;
	};

	multi-led@12 {
		label = "pixel_18";
		reg = <0x12>;
		color = <LED_COLOR_ID_RGB>;
		function = LED_FUNCTION_STATUS;
	};

	multi-led@13 {
		label = "pixel_19";
		reg = <0x13>;
		color = <LED_COLOR_ID_RGB>;
		function = LED_FUNCTION_STATUS;
	};

	multi-led@14 {
		label = "pixel_20";
		reg = <0x14>;
		color = <LED_COLOR_ID_RGB>;
		function = LED_FUNCTION_STATUS;
	};

	multi-led@15 {
		label = "pixel_21";
		reg = <0x15>;
		color = <LED_COLOR_ID_RGB>;
		function = LED_FUNCTION_STATUS;
	};

	multi-led@16 {
		label = "pixel_22";
		reg = <0x16>;
		color = <LED_COLOR_ID_RGB>;
		function = LED_FUNCTION_STATUS;
	};

	multi-led@17 {
		label = "pixel_23";
		reg = <0x17>;
		color = <LED_COLOR_ID_RGB>;
		function = LED_FUNCTION_STATUS;
	};

	multi-led@18 {
		label = "pixel_24";
		reg = <0x18>;
		color = <LED_COLOR_ID_RGB>;
		function = LED_FUNCTION_STATUS;
	};

	multi-led@19 {
		label = "pixel_25";
		reg = <0x19>;
		color = <LED_COLOR_ID_RGB>;
		function = LED_FUNCTION_STATUS;
	};

	multi-led@1A {
		label = "pixel_26";
		reg = <0x1A>;
		color = <LED_COLOR_ID_RGB>;
		function = LED_FUNCTION_STATUS;
	};

	multi-led@1B {
		label = "pixel_27";
		reg = <0x1B>;
		color = <LED_COLOR_ID_RGB>;
		function = LED_FUNCTION_STATUS;
	};

	multi-led@1C {
		label = "pixel_28";
		reg = <0x1C>;
		color = <LED_COLOR_ID_RGB>;
		function = LED_FUNCTION_STATUS;
	};

	multi-led@1D {
		label = "pixel_29";
		reg = <0x1D>;
		color = <LED_COLOR_ID_RGB>;
		function = LED_FUNCTION_STATUS;
	};

	multi-led@1E {
		label = "pixel_30";
		reg = <0x1E>;
		color = <LED_COLOR_ID_RGB>;
		function = LED_FUNCTION_STATUS;
	};

	multi-led@1F {
		label = "pixel_31";
		reg = <0x1F>;
		color = <LED_COLOR_ID_RGB>;
		function = LED_FUNCTION_STATUS;
	};

	multi-led@20 {
		label = "pixel_32";
		reg = <0x20>;
		color = <LED_COLOR_ID_RGB>;
		function = LED_FUNCTION_STATUS;
	};

	multi-led@21 {
		label = "pixel_33";
		reg = <0x21>;
		color = <LED_COLOR_ID_RGB>;
		function = LED_FUNCTION_STATUS;
	};

	multi-led@22 {
		label = "pixel_34";
		reg = <0x22>;
		color = <LED_COLOR_ID_RGB>;
		function = LED_FUNCTION_STATUS;
	};

	multi-led@23 {
		label = "pixel_35";
		reg = <0x23>;
		color = <LED_COLOR_ID_RGB>;
		function = LED_FUNCTION_STATUS;
	};

	multi-led@24 {
		label = "pixel_36";
		reg = <0x24>;
		color = <LED_COLOR_ID_RGB>;
		function = LED_FUNCTION_STATUS;
	};

	multi-led@25 {
		label = "pixel_37";
		reg = <0x25>;
		color = <LED_COLOR_ID_RGB>;
		function = LED_FUNCTION_STATUS;
	};

	multi-led@26 {
		label = "pixel_38";
		reg = <0x26>;
		color = <LED_COLOR_ID_RGB>;
		function = LED_FUNCTION_STATUS;
	};

	multi-led@27 {
		label = "pixel_39";
		reg = <0x27>;
		color = <LED_COLOR_ID_RGB>;
		function = LED_FUNCTION_STATUS;
	};

	multi-led@28 {
		label = "pixel_40";
		reg = <0x28>;
		color = <LED_COLOR_ID_RGB>;
		function = LED_FUNCTION_STATUS;
	};

	multi-led@29 {
		label = "pixel_41";
		reg = <0x29>;
		color = <LED_COLOR_ID_RGB>;
		function = LED_FUNCTION_STATUS;
	};

	multi-led@2A {
		label = "pixel_42";
		reg = <0x2A>;
		color = <LED_COLOR_ID_RGB>;
		function = LED_FUNCTION_STATUS;
	};

	multi-led@2B {
		label = "pixel_43";
		reg = <0x2B>;
		color = <LED_COLOR_ID_RGB>;
		function = LED_FUNCTION_STATUS;
	};

	multi-led@2C {
		label = "pixel_44";
		reg = <0x2C>;
		color = <LED_COLOR_ID_RGB>;
		function = LED_FUNCTION_STATUS;
	};

	multi-led@2D {
		label = "pixel_45";
		reg = <0x2D>;
		color = <LED_COLOR_ID_RGB>;
		function = LED_FUNCTION_STATUS;
	};

	multi-led@2E {
		label = "pixel_46";
		reg = <0x2E>;
		color = <LED_COLOR_ID_RGB>;
		function = LED_FUNCTION_STATUS;
	};

	multi-led@2F {
		label = "pixel_47";
		reg = <0x2F>;
		color = <LED_COLOR_ID_RGB>;
		function = LED_FUNCTION_STATUS;
	};

	multi-led@30 {
		label = "pixel_48";
		reg = <0x30>;
		color = <LED_COLOR_ID_RGB>;
		function = LED_FUNCTION_STATUS;
	};

	multi-led@31 {
		label = "pixel_49";
		reg = <0x31>;
		color = <LED_COLOR_ID_RGB>;
		function = LED_FUNCTION_STATUS;
	};

	multi-led@32 {
		label = "pixel_50";
		reg = <0x32>;
		color = <LED_COLOR_ID_RGB>;
		function = LED_FUNCTION_STATUS;
	};

	multi-led@33 {
		label = "pixel_51";
		reg = <0x33>;
		color = <LED_COLOR_ID_RGB>;
		function = LED_FUNCTION_STATUS;
	};

	multi-led@34 {
		label = "pixel_52";
		reg = <0x34>;
		color = <LED_COLOR_ID_RGB>;
		function = LED_FUNCTION_STATUS;
	};

	multi-led@35 {
		label = "pixel_53";
		reg = <0x35>;
		color = <LED_COLOR_ID_RGB>;
		function = LED_FUNCTION_STATUS;
	};

	multi-led@36 {
		label = "pixel_54";
		reg = <0x36>;
		color = <LED_COLOR_ID_RGB>;
		function = LED_FUNCTION_STATUS;
	};

	multi-led@37 {
		label = "pixel_55";
		reg = <0x37>;
		color = <LED_COLOR_ID_RGB>;
		function = LED_FUNCTION_STATUS;
	};

	multi-led@38 {
		label = "pixel_56";
		reg = <0x38>;
		color = <LED_COLOR_ID_RGB>;
		function = LED_FUNCTION_STATUS;
	};

	multi-led@39 {
		label = "pixel_57";
		reg = <0x39>;
		color = <LED_COLOR_ID_RGB>;
		function = LED_FUNCTION_STATUS;
	};

	multi-led@3A {
		label = "pixel_58";
		reg = <0x3A>;
		color = <LED_COLOR_ID_RGB>;
		function = LED_FUNCTION_STATUS;
	};

	multi-led@3B {
		label = "pixel_59";
		reg = <0x3B>;
		color = <LED_COLOR_ID_RGB>;
		function = LED_FUNCTION_STATUS;
	};

	multi-led@3C {
		label = "pixel_60";
		reg = <0x3C>;
		color = <LED_COLOR_ID_RGB>;
		function = LED_FUNCTION_STATUS;
	};

	multi-led@3D {
		label = "pixel_61";
		reg = <0x3D>;
		color = <LED_COLOR_ID_RGB>;
		function = LED_FUNCTION_STATUS;
	};

	multi-led@3E {
		label = "pixel_62";
		reg = <0x3E>;
		color = <LED_COLOR_ID_RGB>;
		function = LED_FUNCTION_STATUS;
	};

	multi-led@3F {
		label = "pixel_63";
		reg = <0x3F>;
		color = <LED_COLOR_ID_RGB>;
		function = LED_FUNCTION_STATUS;
	};

	multi-led@40 {
		label = "pixel_64";
		reg = <0x40>;
		color = <LED_COLOR_ID_RGB>;
		function = LED_FUNCTION_STATUS;
	};

	multi-led@41 {
		label = "pixel_65";
		reg = <0x41>;
		color = <LED_COLOR_ID_RGB>;
		function = LED_FUNCTION_STATUS;
	};

	multi-led@42 {
		label = "pixel_66";
		reg = <0x42>;
		color = <LED_COLOR_ID_RGB>;
		function = LED_FUNCTION_STATUS;
	};

	multi-led@43 {
		label = "pixel_67";
		reg = <0x43>;
		color = <LED_COLOR_ID_RGB>;
		function = LED_FUNCTION_STATUS;
	};

	multi-led@44 {
		label = "pixel_68";
		reg = <0x44>;
		color = <LED_COLOR_ID_RGB>;
		function = LED_FUNCTION_STATUS;
	};

	multi-led@45 {
		label = "pixel_69";
		reg = <0x45>;
		color = <LED_COLOR_ID_RGB>;
		function = LED_FUNCTION_STATUS;
	};

	multi-led@46 {
		label = "pixel_70";
		reg = <0x46>;
		color = <LED_COLOR_ID_RGB>;
		function = LED_FUNCTION_STATUS;
	};

	multi-led@47 {
		label = "pixel_71";
		reg = <0x47>;
		color = <LED_COLOR_ID_RGB>;
		function = LED_FUNCTION_STATUS;
	};

	multi-led@48 {
		label = "pixel_72";
		reg = <0x48>;
		color = <LED_COLOR_ID_RGB>;
		function = LED_FUNCTION_STATUS;
	};

	multi-led@49 {
		label = "pixel_73";
		reg = <0x49>;
		color = <LED_COLOR_ID_RGB>;
		function = LED_FUNCTION_STATUS;
	};

	multi-led@4A {
		label = "pixel_74";
		reg = <0x4A>;
		color = <LED_COLOR_ID_RGB>;
		function = LED_FUNCTION_STATUS;
	};

	multi-led@4B {
		label = "pixel_75";
		reg = <0x4B>;
		color = <LED_COLOR_ID_RGB>;
		function = LED_FUNCTION_STATUS;
	};

	multi-led@4C {
		label = "pixel_76";
		reg = <0x4C>;
		color = <LED_COLOR_ID_RGB>;
		function = LED_FUNCTION_STATUS;
	};

	multi-led@4D {
		label = "pixel_77";
		reg = <0x4D>;
		color = <LED_COLOR_ID_RGB>;
		function = LED_FUNCTION_STATUS;
	};

	multi-led@4E {
		label = "pixel_78";
		reg = <0x4E>;
		color = <LED_COLOR_ID_RGB>;
		function = LED_FUNCTION_STATUS;
	};

	multi-led@4F {
		label = "pixel_79";
		reg = <0x4F>;
		color = <LED_COLOR_ID_RGB>;
		function = LED_FUNCTION_STATUS;
	};

	multi-led@50 {
		label = "pixel_80";
		reg = <0x50>;
		color = <LED_COLOR_ID_RGB>;
		function = LED_FUNCTION_STATUS;
	};

	multi-led@51 {
		label = "pixel_81";
		reg = <0x51>;
		color = <LED_COLOR_ID_RGB>;
		function = LED_FUNCTION_STATUS;
	};

	multi-led@52 {
		label = "pixel_82";
		reg = <0x52>;
		color = <LED_COLOR_ID_RGB>;
		function = LED_FUNCTION_STATUS;
	};

	multi-led@53 {
		label = "pixel_83";
		reg = <0x53>;
		color = <LED_COLOR_ID_RGB>;
		function = LED_FUNCTION_STATUS;
	};

	multi-led@54 {
		label = "pixel_84";
		reg = <0x54>;
		color = <LED_COLOR_ID_RGB>;
		function = LED_FUNCTION_STATUS;
	};

	multi-led@55 {
		label = "pixel_85";
		reg = <0x55>;
		color = <LED_COLOR_ID_RGB>;
		function = LED_FUNCTION_STATUS;
	};

	multi-led@56 {
		label = "pixel_86";
		reg = <0x56>;
		color = <LED_COLOR_ID_RGB>;
		function = LED_FUNCTION_STATUS;
	};

	multi-led@57 {
		label = "pixel_87";
		reg = <0x57>;
		color = <LED_COLOR_ID_RGB>;
		function = LED_FUNCTION_STATUS;
	};

	multi-led@58 {
		label = "pixel_88";
		reg = <0x58>;
		color = <LED_COLOR_ID_RGB>;
		function = LED_FUNCTION_STATUS;
	};

	multi-led@59 {
		label = "pixel_89";
		reg = <0x59>;
		color = <LED_COLOR_ID_RGB>;
		function = LED_FUNCTION_STATUS;
	};

	multi-led@5A {
		label = "pixel_90";
		reg = <0x5A>;
		color = <LED_COLOR_ID_RGB>;
		function = LED_FUNCTION_STATUS;
	};

	multi-led@5B {
		label = "pixel_91";
		reg = <0x5B>;
		color = <LED_COLOR_ID_RGB>;
		function = LED_FUNCTION_STATUS;
	};

	multi-led@5C {
		label = "pixel_92";
		reg = <0x5C>;
		color = <LED_COLOR_ID_RGB>;
		function = LED_FUNCTION_STATUS;
	};

	multi-led@5D {
		label = "pixel_93";
		reg = <0x5D>;
		color = <LED_COLOR_ID_RGB>;
		function = LED_FUNCTION_STATUS;
	};

	multi-led@5E {
		label = "pixel_94";
		reg = <0x5E>;
		color = <LED_COLOR_ID_RGB>;
		function = LED_FUNCTION_STATUS;
	};

	multi-led@5F {
		label = "pixel_95";
		reg = <0x5F>;
		color = <LED_COLOR_ID_RGB>;
		function = LED_FUNCTION_STATUS;
	};

	multi-led@60 {
		label = "pixel_96";
		reg = <0x60>;
		color = <LED_COLOR_ID_RGB>;
		function = LED_FUNCTION_STATUS;
	};

	multi-led@61 {
		label = "pixel_97";
		reg = <0x61>;
		color = <LED_COLOR_ID_RGB>;
		function = LED_FUNCTION_STATUS;
	};

	multi-led@62 {
		label = "pixel_98";
		reg = <0x62>;
		color = <LED_COLOR_ID_RGB>;
		function = LED_FUNCTION_STATUS;
	};

	multi-led@63 {
		label = "pixel_99";
		reg = <0x63>;
		color = <LED_COLOR_ID_RGB>;
		function = LED_FUNCTION_STATUS;
	};

	multi-led@64 {
		label = "pixel_100";
		reg = <0x64>;
		color = <LED_COLOR_ID_RGB>;
		function = LED_FUNCTION_STATUS;
	};

	multi-led@65 {
		label = "pixel_101";
		reg = <0x65>;
		color = <LED_COLOR_ID_RGB>;
		function = LED_FUNCTION_STATUS;
	};

	multi-led@66 {
		label = "pixel_102";
		reg = <0x66>;
		color = <LED_COLOR_ID_RGB>;
		function = LED_FUNCTION_STATUS;
	};

	multi-led@67 {
		label = "pixel_103";
		reg = <0x67>;
		color = <LED_COLOR_ID_RGB>;
		function = LED_FUNCTION_STATUS;
	};

	multi-led@68 {
		label = "pixel_104";
		reg = <0x68>;
		color = <LED_COLOR_ID_RGB>;
		function = LED_FUNCTION_STATUS;
	};

	multi-led@69 {
		label = "pixel_105";
		reg = <0x69>;
		color = <LED_COLOR_ID_RGB>;
		function = LED_FUNCTION_STATUS;
	};

	multi-led@6A {
		label = "pixel_106";
		reg = <0x6A>;
		color = <LED_COLOR_ID_RGB>;
		function = LED_FUNCTION_STATUS;
	};

	multi-led@6B {
		label = "pixel_107";
		reg = <0x6B>;
		color = <LED_COLOR_ID_RGB>;
		function = LED_FUNCTION_STATUS;
	};

	multi-led@6C {
		label = "pixel_108";
		reg = <0x6C>;
		color = <LED_COLOR_ID_RGB>;
		function = LED_FUNCTION_STATUS;
	};

	multi-led@6D {
		label = "pixel_109";
		reg = <0x6D>;
		color = <LED_COLOR_ID_RGB>;
		function = LED_FUNCTION_STATUS;
	};

	multi-led@6E {
		label = "pixel_110";
		reg = <0x6E>;
		color = <LED_COLOR_ID_RGB>;
		function = LED_FUNCTION_STATUS;
	};

	multi-led@6F {
		label = "pixel_111";
		reg = <0x6F>;
		color = <LED_COLOR_ID_RGB>;
		function = LED_FUNCTION_STATUS;
	};

	multi-led@70 {
		label = "pixel_112";
		reg = <0x70>;
		color = <LED_COLOR_ID_RGB>;
		function = LED_FUNCTION_STATUS;
	};

	multi-led@71 {
		label = "pixel_113";
		reg = <0x71>;
		color = <LED_COLOR_ID_RGB>;
		function = LED_FUNCTION_STATUS;
	};

	multi-led@72 {
		label = "pixel_114";
		reg = <0x72>;
		color = <LED_COLOR_ID_RGB>;
		function = LED_FUNCTION_STATUS;
	};

	multi-led@73 {
		label = "pixel_115";
		reg = <0x73>;
		color = <LED_COLOR_ID_RGB>;
		function = LED_FUNCTION_STATUS;
	};

	multi-led@74 {
		label = "pixel_116";
		reg = <0x74>;
		color = <LED_COLOR_ID_RGB>;
		function = LED_FUNCTION_STATUS;
	};

	multi-led@75 {
		label = "pixel_117";
		reg = <0x75>;
		color = <LED_COLOR_ID_RGB>;
		function = LED_FUNCTION_STATUS;
	};

	multi-led@76 {
		label = "pixel_118";
		reg = <0x76>;
		color = <LED_COLOR_ID_RGB>;
		function = LED_FUNCTION_STATUS;
	};

	multi-led@77 {
		label = "pixel_119";
		reg = <0x77>;
		color = <LED_COLOR_ID_RGB>;
		function = LED_FUNCTION_STATUS;
	};

	multi-led@78 {
		label = "pixel_120";
		reg = <0x78>;
		color = <LED_COLOR_ID_RGB>;
		function = LED_FUNCTION_STATUS;
	};

	multi-led@79 {
		label = "pixel_121";
		reg = <0x79>;
		color = <LED_COLOR_ID_RGB>;
		function = LED_FUNCTION_STATUS;
	};

	multi-led@7A {
		label = "pixel_122";
		reg = <0x7A>;
		color = <LED_COLOR_ID_RGB>;
		function = LED_FUNCTION_STATUS;
	};

	multi-led@7B {
		label = "pixel_123";
		reg = <0x7B>;
		color = <LED_COLOR_ID_RGB>;
		function = LED_FUNCTION_STATUS;
	};

	multi-led@7C {
		label = "pixel_124";
		reg = <0x7C>;
		color = <LED_COLOR_ID_RGB>;
		function = LED_FUNCTION_STATUS;
	};

	multi-led@7D {
		label = "pixel_125";
		reg = <0x7D>;
		color = <LED_COLOR_ID_RGB>;
		function = LED_FUNCTION_STATUS;
	};

	multi-led@7E {
		label = "pixel_126";
		reg = <0x7E>;
		color = <LED_COLOR_ID_RGB>;
		function = LED_FUNCTION_STATUS;
	};

	multi-led@7F {
		label = "pixel_127";
		reg = <0x7F>;
		color = <LED_COLOR_ID_RGB>;
		function = LED_FUNCTION_STATUS;
	};

	multi-led@80 {
		label = "pixel_128";
		reg = <0x80>;
		color = <LED_COLOR_ID_RGB>;
		function = LED_FUNCTION_STATUS;
	};

	multi-led@81 {
		label = "pixel_129";
		reg = <0x81>;
		color = <LED_COLOR_ID_RGB>;
		function = LED_FUNCTION_STATUS;
	};

	multi-led@82 {
		label = "pixel_130";
		reg = <0x82>;
		color = <LED_COLOR_ID_RGB>;
		function = LED_FUNCTION_STATUS;
	};

	multi-led@83 {
		label = "pixel_131";
		reg = <0x83>;
		color = <LED_COLOR_ID_RGB>;
		function = LED_FUNCTION_STATUS;
	};

	multi-led@84 {
		label = "pixel_132";
		reg = <0x84>;
		color = <LED_COLOR_ID_RGB>;
		function = LED_FUNCTION_STATUS;
	};

	multi-led@85 {
		label = "pixel_133";
		reg = <0x85>;
		color = <LED_COLOR_ID_RGB>;
		function = LED_FUNCTION_STATUS;
	};

	multi-led@86 {
		label = "pixel_134";
		reg = <0x86>;
		color = <LED_COLOR_ID_RGB>;
		function = LED_FUNCTION_STATUS;
	};

	multi-led@87 {
		label = "pixel_135";
		reg = <0x87>;
		color = <LED_COLOR_ID_RGB>;
		function = LED_FUNCTION_STATUS;
	};

	multi-led@88 {
		label = "pixel_136";
		reg = <0x88>;
		color = <LED_COLOR_ID_RGB>;
		function = LED_FUNCTION_STATUS;
	};

	multi-led@89 {
		label = "pixel_137";
		reg = <0x89>;
		color = <LED_COLOR_ID_RGB>;
		function = LED_FUNCTION_STATUS;
	};

	multi-led@8A {
		label = "pixel_138";
		reg = <0x8A>;
		color = <LED_COLOR_ID_RGB>;
		function = LED_FUNCTION_STATUS;
	};

	multi-led@8B {
		label = "pixel_139";
		reg = <0x8B>;
		color = <LED_COLOR_ID_RGB>;
		function = LED_FUNCTION_STATUS;
	};

	multi-led@8C {
		label = "pixel_140";
		reg = <0x8C>;
		color = <LED_COLOR_ID_RGB>;
		function = LED_FUNCTION_STATUS;
	};

	multi-led@8D {
		label = "pixel_141";
		reg = <0x8D>;
		color = <LED_COLOR_ID_RGB>;
		function = LED_FUNCTION_STATUS;
	};

	multi-led@8E {
		label = "pixel_142";
		reg = <0x8E>;
		color = <LED_COLOR_ID_RGB>;
		function = LED_FUNCTION_STATUS;
	};

	multi-led@8F {
		label = "pixel_143";
		reg = <0x8F>;
		color = <LED_COLOR_ID_RGB>;
		function = LED_FUNCTION_STATUS;
	};

	multi-led@90 {
		label = "pixel_144";
		reg = <0x90>;
		color = <LED_COLOR_ID_RGB>;
		function = LED_FUNCTION_STATUS;
	};

	multi-led@91 {
		label = "pixel_145";
		reg = <0x91>;
		color = <LED_COLOR_ID_RGB>;
		function = LED_FUNCTION_STATUS;
	};

	multi-led@92 {
		label = "pixel_146";
		reg = <0x92>;
		color = <LED_COLOR_ID_RGB>;
		function = LED_FUNCTION_STATUS;
	};

	multi-led@93 {
		label = "pixel_147";
		reg = <0x93>;
		color = <LED_COLOR_ID_RGB>;
		function = LED_FUNCTION_STATUS;
	};

	multi-led@94 {
		label = "pixel_148";
		reg = <0x94>;
		color = <LED_COLOR_ID_RGB>;
		function = LED_FUNCTION_STATUS;
	};

	multi-led@95 {
		label = "pixel_149";
		reg = <0x95>;
		color = <LED_COLOR_ID_RGB>;
		function = LED_FUNCTION_STATUS;
	};

	multi-led@96 {
		label = "pixel_150";
		reg = <0x96>;
		color = <LED_COLOR_ID_RGB>;
		function = LED_FUNCTION_STATUS;
	};

	multi-led@97 {
		label = "pixel_151";
		reg = <0x97>;
		color = <LED_COLOR_ID_RGB>;
		function = LED_FUNCTION_STATUS;
	};

	multi-led@98 {
		label = "pixel_152";
		reg = <0x98>;
		color = <LED_COLOR_ID_RGB>;
		function = LED_FUNCTION_STATUS;
	};

	multi-led@99 {
		label = "pixel_153";
		reg = <0x99>;
		color = <LED_COLOR_ID_RGB>;
		function = LED_FUNCTION_STATUS;
	};

	multi-led@9A {
		label = "pixel_154";
		reg = <0x9A>;
		color = <LED_COLOR_ID_RGB>;
		function = LED_FUNCTION_STATUS;
	};

	multi-led@9B {
		label = "pixel_155";
		reg = <0x9B>;
		color = <LED_COLOR_ID_RGB>;
		function = LED_FUNCTION_STATUS;
	};

	multi-led@9C {
		label = "pixel_156";
		reg = <0x9C>;
		color = <LED_COLOR_ID_RGB>;
		function = LED_FUNCTION_STATUS;
	};

	multi-led@9D {
		label = "pixel_157";
		reg = <0x9D>;
		color = <LED_COLOR_ID_RGB>;
		function = LED_FUNCTION_STATUS;
	};

	multi-led@9E {
		label = "pixel_158";
		reg = <0x9E>;
		color = <LED_COLOR_ID_RGB>;
		function = LED_FUNCTION_STATUS;
	};

	multi-led@9F {
		label = "pixel_159";
		reg = <0x9F>;
		color = <LED_COLOR_ID_RGB>;
		function = LED_FUNCTION_STATUS;
	};

	multi-led@A0 {
		label = "pixel_160";
		reg = <0xA0>;
		color = <LED_COLOR_ID_RGB>;
		function = LED_FUNCTION_STATUS;
	};

	multi-led@A1 {
		label = "pixel_161";
		reg = <0xA1>;
		color = <LED_COLOR_ID_RGB>;
		function = LED_FUNCTION_STATUS;
	};

	multi-led@A2 {
		label = "pixel_162";
		reg = <0xA2>;
		color = <LED_COLOR_ID_RGB>;
		function = LED_FUNCTION_STATUS;
	};

	multi-led@A3 {
		label = "pixel_163";
		reg = <0xA3>;
		color = <LED_COLOR_ID_RGB>;
		function = LED_FUNCTION_STATUS;
	};

	multi-led@A4 {
		label = "pixel_164";
		reg = <0xA4>;
		color = <LED_COLOR_ID_RGB>;
		function = LED_FUNCTION_STATUS;
	};

	multi-led@A5 {
		label = "pixel_165";
		reg = <0xA5>;
		color = <LED_COLOR_ID_RGB>;
		function = LED_FUNCTION_STATUS;
	};

	multi-led@A6 {
		label = "pixel_166";
		reg = <0xA6>;
		color = <LED_COLOR_ID_RGB>;
		function = LED_FUNCTION_STATUS;
	};

	multi-led@A7 {
		label = "pixel_167";
		reg = <0xA7>;
		color = <LED_COLOR_ID_RGB>;
		function = LED_FUNCTION_STATUS;
	};

	multi-led@A8 {
		label = "pixel_168";
		reg = <0xA8>;
		color = <LED_COLOR_ID_RGB>;
		function = LED_FUNCTION_STATUS;
	};

	multi-led@A9 {
		label = "pixel_169";
		reg = <0xA9>;
		color = <LED_COLOR_ID_RGB>;
		function = LED_FUNCTION_STATUS;
	};

	multi-led@AA {
		label = "pixel_170";
		reg = <0xAA>;
		color = <LED_COLOR_ID_RGB>;
		function = LED_FUNCTION_STATUS;
	};

	multi-led@AB {
		label = "pixel_171";
		reg = <0xAB>;
		color = <LED_COLOR_ID_RGB>;
		function = LED_FUNCTION_STATUS;
	};

	multi-led@AC {
		label = "pixel_172";
		reg = <0xAC>;
		color = <LED_COLOR_ID_RGB>;
		function = LED_FUNCTION_STATUS;
	};

	multi-led@AD {
		label = "pixel_173";
		reg = <0xAD>;
		color = <LED_COLOR_ID_RGB>;
		function = LED_FUNCTION_STATUS;
	};

	multi-led@AE {
		label = "pixel_174";
		reg = <0xAE>;
		color = <LED_COLOR_ID_RGB>;
		function = LED_FUNCTION_STATUS;
	};

	multi-led@AF {
		label = "pixel_175";
		reg = <0xAF>;
		color = <LED_COLOR_ID_RGB>;
		function = LED_FUNCTION_STATUS;
	};

	multi-led@B0 {
		label = "pixel_176";
		reg = <0xB0>;
		color = <LED_COLOR_ID_RGB>;
		function = LED_FUNCTION_STATUS;
	};

	multi-led@B1 {
		label = "pixel_177";
		reg = <0xB1>;
		color = <LED_COLOR_ID_RGB>;
		function = LED_FUNCTION_STATUS;
	};

	multi-led@B2 {
		label = "pixel_178";
		reg = <0xB2>;
		color = <LED_COLOR_ID_RGB>;
		function = LED_FUNCTION_STATUS;
	};

	multi-led@B3 {
		label = "pixel_179";
		reg = <0xB3>;
		color = <LED_COLOR_ID_RGB>;
		function = LED_FUNCTION_STATUS;
	};

	multi-led@B4 {
		label = "pixel_180";
		reg = <0xB4>;
		color = <LED_COLOR_ID_RGB>;
		function = LED_FUNCTION_STATUS;
	};

	multi-led@B5 {
		label = "pixel_181";
		reg = <0xB5>;
		color = <LED_COLOR_ID_RGB>;
		function = LED_FUNCTION_STATUS;
	};

	multi-led@B6 {
		label = "pixel_182";
		reg = <0xB6>;
		color = <LED_COLOR_ID_RGB>;
		function = LED_FUNCTION_STATUS;
	};

	multi-led@B7 {
		label = "pixel_183";
		reg = <0xB7>;
		color = <LED_COLOR_ID_RGB>;
		function = LED_FUNCTION_STATUS;
	};

	multi-led@B8 {
		label = "pixel_184";
		reg = <0xB8>;
		color = <LED_COLOR_ID_RGB>;
		function = LED_FUNCTION_STATUS;
	};

	multi-led@B9 {
		label = "pixel_185";
		reg = <0xB9>;
		color = <LED_COLOR_ID_RGB>;
		function = LED_FUNCTION_STATUS;
	};

	multi-led@BA {
		label = "pixel_186";
		reg = <0xBA>;
		color = <LED_COLOR_ID_RGB>;
		function = LED_FUNCTION_STATUS;
	};

	multi-led@BB {
		label = "pixel_187";
		reg = <0xBB>;
		color = <LED_COLOR_ID_RGB>;
		function = LED_FUNCTION_STATUS;
	};

	multi-led@BC {
		label = "pixel_188";
		reg = <0xBC>;
		color = <LED_COLOR_ID_RGB>;
		function = LED_FUNCTION_STATUS;
	};

	multi-led@BD {
		label = "pixel_189";
		reg = <0xBD>;
		color = <LED_COLOR_ID_RGB>;
		function = LED_FUNCTION_STATUS;
	};

	multi-led@BE {
		label = "pixel_190";
		reg = <0xBE>;
		color = <LED_COLOR_ID_RGB>;
		function = LED_FUNCTION_STATUS;
	};

	multi-led@BF {
		label = "pixel_191";
		reg = <0xBF>;
		color = <LED_COLOR_ID_RGB>;
		function = LED_FUNCTION_STATUS;
	};

	multi-led@C0 {
		label = "pixel_192";
		reg = <0xC0>;
		color = <LED_COLOR_ID_RGB>;
		function = LED_FUNCTION_STATUS;
	};

	multi-led@C1 {
		label = "pixel_193";
		reg = <0xC1>;
		color = <LED_COLOR_ID_RGB>;
		function = LED_FUNCTION_STATUS;
	};

	multi-led@C2 {
		label = "pixel_194";
		reg = <0xC2>;
		color = <LED_COLOR_ID_RGB>;
		function = LED_FUNCTION_STATUS;
	};

	multi-led@C3 {
		label = "pixel_195";
		reg = <0xC3>;
		color = <LED_COLOR_ID_RGB>;
		function = LED_FUNCTION_STATUS;
	};

	multi-led@C4 {
		label = "pixel_196";
		reg = <0xC4>;
		color = <LED_COLOR_ID_RGB>;
		function = LED_FUNCTION_STATUS;
	};

	multi-led@C5 {
		label = "pixel_197";
		reg = <0xC5>;
		color = <LED_COLOR_ID_RGB>;
		function = LED_FUNCTION_STATUS;
	};

	multi-led@C6 {
		label = "pixel_198";
		reg = <0xC6>;
		color = <LED_COLOR_ID_RGB>;
		function = LED_FUNCTION_STATUS;
	};

	multi-led@C7 {
		label = "pixel_199";
		reg = <0xC7>;
		color = <LED_COLOR_ID_RGB>;
		function = LED_FUNCTION_STATUS;
	};

	multi-led@C8 {
		label = "pixel_200";
		reg = <0xC8>;
		color = <LED_COLOR_ID_RGB>;
		function = LED_FUNCTION_STATUS;
	};

	multi-led@C9 {
		label = "pixel_201";
		reg = <0xC9>;
		color = <LED_COLOR_ID_RGB>;
		function = LED_FUNCTION_STATUS;
	};

	multi-led@CA {
		label = "pixel_202";
		reg = <0xCA>;
		color = <LED_COLOR_ID_RGB>;
		function = LED_FUNCTION_STATUS;
	};

	multi-led@CB {
		label = "pixel_203";
		reg = <0xCB>;
		color = <LED_COLOR_ID_RGB>;
		function = LED_FUNCTION_STATUS;
	};

	multi-led@CC {
		label = "pixel_204";
		reg = <0xCC>;
		color = <LED_COLOR_ID_RGB>;
		function = LED_FUNCTION_STATUS;
	};

	multi-led@CD {
		label = "pixel_205";
		reg = <0xCD>;
		color = <LED_COLOR_ID_RGB>;
		function = LED_FUNCTION_STATUS;
	};

	multi-led@CE {
		label = "pixel_206";
		reg = <0xCE>;
		color = <LED_COLOR_ID_RGB>;
		function = LED_FUNCTION_STATUS;
	};

	multi-led@CF {
		label = "pixel_207";
		reg = <0xCF>;
		color = <LED_COLOR_ID_RGB>;
		function = LED_FUNCTION_STATUS;
	};

	multi-led@D0 {
		label = "pixel_208";
		reg = <0xD0>;
		color = <LED_COLOR_ID_RGB>;
		function = LED_FUNCTION_STATUS;
	};

	multi-led@D1 {
		label = "pixel_209";
		reg = <0xD1>;
		color = <LED_COLOR_ID_RGB>;
		function = LED_FUNCTION_STATUS;
	};

	multi-led@D2 {
		label = "pixel_210";
		reg = <0xD2>;
		color = <LED_COLOR_ID_RGB>;
		function = LED_FUNCTION_STATUS;
	};

	multi-led@D3 {
		label = "pixel_211";
		reg = <0xD3>;
		color = <LED_COLOR_ID_RGB>;
		function = LED_FUNCTION_STATUS;
	};

	multi-led@D4 {
		label = "pixel_212";
		reg = <0xD4>;
		color = <LED_COLOR_ID_RGB>;
		function = LED_FUNCTION_STATUS;
	};

	multi-led@D5 {
		label = "pixel_213";
		reg = <0xD5>;
		color = <LED_COLOR_ID_RGB>;
		function = LED_FUNCTION_STATUS;
	};

	multi-led@D6 {
		label = "pixel_214";
		reg = <0xD6>;
		color = <LED_COLOR_ID_RGB>;
		function = LED_FUNCTION_STATUS;
	};

	multi-led@D7 {
		label = "pixel_215";
		reg = <0xD7>;
		color = <LED_COLOR_ID_RGB>;
		function = LED_FUNCTION_STATUS;
	};

	multi-led@D8 {
		label = "pixel_216";
		reg = <0xD8>;
		color = <LED_COLOR_ID_RGB>;
		function = LED_FUNCTION_STATUS;
	};

	multi-led@D9 {
		label = "pixel_217";
		reg = <0xD9>;
		color = <LED_COLOR_ID_RGB>;
		function = LED_FUNCTION_STATUS;
	};

	multi-led@DA {
		label = "pixel_218";
		reg = <0xDA>;
		color = <LED_COLOR_ID_RGB>;
		function = LED_FUNCTION_STATUS;
	};

	multi-led@DB {
		label = "pixel_219";
		reg = <0xDB>;
		color = <LED_COLOR_ID_RGB>;
		function = LED_FUNCTION_STATUS;
	};

	multi-led@DC {
		label = "pixel_220";
		reg = <0xDC>;
		color = <LED_COLOR_ID_RGB>;
		function = LED_FUNCTION_STATUS;
	};

	multi-led@DD {
		label = "pixel_221";
		reg = <0xDD>;
		color = <LED_COLOR_ID_RGB>;
		function = LED_FUNCTION_STATUS;
	};

	multi-led@DE {
		label = "pixel_222";
		reg = <0xDE>;
		color = <LED_COLOR_ID_RGB>;
		function = LED_FUNCTION_STATUS;
	};

	multi-led@DF {
		label = "pixel_223";
		reg = <0xDF>;
		color = <LED_COLOR_ID_RGB>;
		function = LED_FUNCTION_STATUS;
	};

	multi-led@E0 {
		label = "pixel_224";
		reg = <0xE0>;
		color = <LED_COLOR_ID_RGB>;
		function = LED_FUNCTION_STATUS;
	};

	multi-led@E1 {
		label = "pixel_225";
		reg = <0xE1>;
		color = <LED_COLOR_ID_RGB>;
		function = LED_FUNCTION_STATUS;
	};

	multi-led@E2 {
		label = "pixel_226";
		reg = <0xE2>;
		color = <LED_COLOR_ID_RGB>;
		function = LED_FUNCTION_STATUS;
	};

	multi-led@E3 {
		label = "pixel_227";
		reg = <0xE3>;
		color = <LED_COLOR_ID_RGB>;
		function = LED_FUNCTION_STATUS;
	};

	multi-led@E4 {
		label = "pixel_228";
		reg = <0xE4>;
		color = <LED_COLOR_ID_RGB>;
		function = LED_FUNCTION_STATUS;
	};

	multi-led@E5 {
		label = "pixel_229";
		reg = <0xE5>;
		color = <LED_COLOR_ID_RGB>;
		function = LED_FUNCTION_STATUS;
	};

	multi-led@E6 {
		label = "pixel_230";
		reg = <0xE6>;
		color = <LED_COLOR_ID_RGB>;
		function = LED_FUNCTION_STATUS;
	};

	multi-led@E7 {
		label = "pixel_231";
		reg = <0xE7>;
		color = <LED_COLOR_ID_RGB>;
		function = LED_FUNCTION_STATUS;
	};

	multi-led@E8 {
		label = "pixel_232";
		reg = <0xE8>;
		color = <LED_COLOR_ID_RGB>;
		function = LED_FUNCTION_STATUS;
	};

	multi-led@E9 {
		label = "pixel_233";
		reg = <0xE9>;
		color = <LED_COLOR_ID_RGB>;
		function = LED_FUNCTION_STATUS;
	};

	multi-led@EA {
		label = "pixel_234";
		reg = <0xEA>;
		color = <LED_COLOR_ID_RGB>;
		function = LED_FUNCTION_STATUS;
	};

	multi-led@EB {
		label = "pixel_235";
		reg = <0xEB>;
		color = <LED_COLOR_ID_RGB>;
		function = LED_FUNCTION_STATUS;
	};

	multi-led@EC {
		label = "pixel_236";
		reg = <0xEC>;
		color = <LED_COLOR_ID_RGB>;
		function = LED_FUNCTION_STATUS;
	};

	multi-led@ED {
		label = "pixel_237";
		reg = <0xED>;
		color = <LED_COLOR_ID_RGB>;
		function = LED_FUNCTION_STATUS;
	};

	multi-led@EE {
		label = "pixel_238";
		reg = <0xEE>;
		color = <LED_COLOR_ID_RGB>;
		function = LED_FUNCTION_STATUS;
	};

	multi-led@EF {
		label = "pixel_239";
		reg = <0xEF>;
		color = <LED_COLOR_ID_RGB>;
		function = LED_FUNCTION_STATUS;
	};

	multi-led@F0 {
		label = "pixel_240";
		reg = <0xF0>;
		color = <LED_COLOR_ID_RGB>;
		function = LED_FUNCTION_STATUS;
	};

	multi-led@F1 {
		label = "pixel_241";
		reg = <0xF1>;
		color = <LED_COLOR_ID_RGB>;
		function = LED_FUNCTION_STATUS;
	};

	multi-led@F2 {
		label = "pixel_242";
		reg = <0xF2>;
		color = <LED_COLOR_ID_RGB>;
		function = LED_FUNCTION_STATUS;
	};

	multi-led@F3 {
		label = "pixel_243";
		reg = <0xF3>;
		color = <LED_COLOR_ID_RGB>;
		function = LED_FUNCTION_STATUS;
	};

	multi-led@F4 {
		label = "pixel_244";
		reg = <0xF4>;
		color = <LED_COLOR_ID_RGB>;
		function = LED_FUNCTION_STATUS;
	};

	multi-led@F5 {
		label = "pixel_245";
		reg = <0xF5>;
		color = <LED_COLOR_ID_RGB>;
		function = LED_FUNCTION_STATUS;
	};

	multi-led@F6 {
		label = "pixel_246";
		reg = <0xF6>;
		color = <LED_COLOR_ID_RGB>;
		function = LED_FUNCTION_STATUS;
	};

	multi-led@F7 {
		label = "pixel_247";
		reg = <0xF7>;
		color = <LED_COLOR_ID_RGB>;
		function = LED_FUNCTION_STATUS;
	};

	multi-led@F8 {
		label = "pixel_248";
		reg = <0xF8>;
		color = <LED_COLOR_ID_RGB>;
		function = LED_FUNCTION_STATUS;
	};

	multi-led@F9 {
		label = "pixel_249";
		reg = <0xF9>;
		color = <LED_COLOR_ID_RGB>;
		function = LED_FUNCTION_STATUS;
	};

	multi-led@FA {
		label = "pixel_250";
		reg = <0xFA>;
		color = <LED_COLOR_ID_RGB>;
		function = LED_FUNCTION_STATUS;
	};

	multi-led@FB {
		label = "pixel_251";
		reg = <0xFB>;
		color = <LED_COLOR_ID_RGB>;
		function = LED_FUNCTION_STATUS;
	};

	multi-led@FC {
		label = "pixel_252";
		reg = <0xFC>;
		color = <LED_COLOR_ID_RGB>;
		function = LED_FUNCTION_STATUS;
	};

	multi-led@FD {
		label = "pixel_253";
		reg = <0xFD>;
		color = <LED_COLOR_ID_RGB>;
		function = LED_FUNCTION_STATUS;
	};

	multi-led@FE {
		label = "pixel_254";
		reg = <0xFE>;
		color = <LED_COLOR_ID_RGB>;
		function = LED_FUNCTION_STATUS;
	};

	multi-led@FF {
		label = "pixel_255";
		reg = <0xFF>;
		color = <LED_COLOR_ID_RGB>;
		function = LED_FUNCTION_STATUS;
	};

	multi-led@100 {
		label = "pixel_256";
		reg = <0x100>;
		color = <LED_COLOR_ID_RGB>;
		function = LED_FUNCTION_STATUS;
	};

	multi-led@101 {
		label = "pixel_257";
		reg = <0x101>;
		color = <LED_COLOR_ID_RGB>;
		function = LED_FUNCTION_STATUS;
	};

	multi-led@102 {
		label = "pixel_258";
		reg = <0x102>;
		color = <LED_COLOR_ID_RGB>;
		function = LED_FUNCTION_STATUS;
	};

	multi-led@103 {
		label = "pixel_259";
		reg = <0x103>;
		color = <LED_COLOR_ID_RGB>;
		function = LED_FUNCTION_STATUS;
	};

	multi-led@104 {
		label = "pixel_260";
		reg = <0x104>;
		color = <LED_COLOR_ID_RGB>;
		function = LED_FUNCTION_STATUS;
	};

	multi-led@105 {
		label = "pixel_261";
		reg = <0x105>;
		color = <LED_COLOR_ID_RGB>;
		function = LED_FUNCTION_STATUS;
	};

	multi-led@106 {
		label = "pixel_262";
		reg = <0x106>;
		color = <LED_COLOR_ID_RGB>;
		function = LED_FUNCTION_STATUS;
	};

	multi-led@107 {
		label = "pixel_263";
		reg = <0x107>;
		color = <LED_COLOR_ID_RGB>;
		function = LED_FUNCTION_STATUS;
	};

	multi-led@108 {
		label = "pixel_264";
		reg = <0x108>;
		color = <LED_COLOR_ID_RGB>;
		function = LED_FUNCTION_STATUS;
	};

	multi-led@109 {
		label = "pixel_265";
		reg = <0x109>;
		color = <LED_COLOR_ID_RGB>;
		function = LED_FUNCTION_STATUS;
	};

	multi-led@10A {
		label = "pixel_266";
		reg = <0x10A>;
		color = <LED_COLOR_ID_RGB>;
		function = LED_FUNCTION_STATUS;
	};

	multi-led@10B {
		label = "pixel_267";
		reg = <0x10B>;
		color = <LED_COLOR_ID_RGB>;
		function = LED_FUNCTION_STATUS;
	};

	multi-led@10C {
		label = "pixel_268";
		reg = <0x10C>;
		color = <LED_COLOR_ID_RGB>;
		function = LED_FUNCTION_STATUS;
	};

	multi-led@10D {
		label = "pixel_269";
		reg = <0x10D>;
		color = <LED_COLOR_ID_RGB>;
		function = LED_FUNCTION_STATUS;
	};

	multi-led@10E {
		label = "pixel_270";
		reg = <0x10E>;
		color = <LED_COLOR_ID_RGB>;
		function = LED_FUNCTION_STATUS;
	};

	multi-led@10F {
		label = "pixel_271";
		reg = <0x10F>;
		color = <LED_COLOR_ID_RGB>;
		function = LED_FUNCTION_STATUS;
	};

	multi-led@110 {
		label = "pixel_272";
		reg = <0x110>;
		color = <LED_COLOR_ID_RGB>;
		function = LED_FUNCTION_STATUS;
	};

	multi-led@111 {
		label = "pixel_273";
		reg = <0x111>;
		color = <LED_COLOR_ID_RGB>;
		function = LED_FUNCTION_STATUS;
	};

	multi-led@112 {
		label = "pixel_274";
		reg = <0x112>;
		color = <LED_COLOR_ID_RGB>;
		function = LED_FUNCTION_STATUS;
	};

	multi-led@113 {
		label = "pixel_275";
		reg = <0x113>;
		color = <LED_COLOR_ID_RGB>;
		function = LED_FUNCTION_STATUS;
	};

	multi-led@114 {
		label = "pixel_276";
		reg = <0x114>;
		color = <LED_COLOR_ID_RGB>;
		function = LED_FUNCTION_STATUS;
	};

	multi-led@115 {
		label = "pixel_277";
		reg = <0x115>;
		color = <LED_COLOR_ID_RGB>;
		function = LED_FUNCTION_STATUS;
	};

	multi-led@116 {
		label = "pixel_278";
		reg = <0x116>;
		color = <LED_COLOR_ID_RGB>;
		function = LED_FUNCTION_STATUS;
	};

	multi-led@117 {
		label = "pixel_279";
		reg = <0x117>;
		color = <LED_COLOR_ID_RGB>;
		function = LED_FUNCTION_STATUS;
	};

	multi-led@118 {
		label = "pixel_280";
		reg = <0x118>;
		color = <LED_COLOR_ID_RGB>;
		function = LED_FUNCTION_STATUS;
	};

	multi-led@119 {
		label = "pixel_281";
		reg = <0x119>;
		color = <LED_COLOR_ID_RGB>;
		function = LED_FUNCTION_STATUS;
	};

	multi-led@11A {
		label = "pixel_282";
		reg = <0x11A>;
		color = <LED_COLOR_ID_RGB>;
		function = LED_FUNCTION_STATUS;
	};

	multi-led@11B {
		label = "pixel_283";
		reg = <0x11B>;
		color = <LED_COLOR_ID_RGB>;
		function = LED_FUNCTION_STATUS;
	};

	multi-led@11C {
		label = "pixel_284";
		reg = <0x11C>;
		color = <LED_COLOR_ID_RGB>;
		function = LED_FUNCTION_STATUS;
	};

	multi-led@11D {
		label = "pixel_285";
		reg = <0x11D>;
		color = <LED_COLOR_ID_RGB>;
		function = LED_FUNCTION_STATUS;
	};

	multi-led@11E {
		label = "pixel_286";
		reg = <0x11E>;
		color = <LED_COLOR_ID_RGB>;
		function = LED_FUNCTION_STATUS;
	};

	multi-led@11F {
		label = "pixel_287";
		reg = <0x11F>;
		color = <LED_COLOR_ID_RGB>;
		function = LED_FUNCTION_STATUS;
	};

	multi-led@120 {
		label = "pixel_288";
		reg = <0x120>;
		color = <LED_COLOR_ID_RGB>;
		function = LED_FUNCTION_STATUS;
	};

	multi-led@121 {
		label = "pixel_289";
		reg = <0x121>;
		color = <LED_COLOR_ID_RGB>;
		function = LED_FUNCTION_STATUS;
	};

	multi-led@122 {
		label = "pixel_290";
		reg = <0x122>;
		color = <LED_COLOR_ID_RGB>;
		function = LED_FUNCTION_STATUS;
	};

	multi-led@123 {
		label = "pixel_291";
		reg = <0x123>;
		color = <LED_COLOR_ID_RGB>;
		function = LED_FUNCTION_STATUS;
	};

	multi-led@124 {
		label = "pixel_292";
		reg = <0x124>;
		color = <LED_COLOR_ID_RGB>;
		function = LED_FUNCTION_STATUS;
	};

	multi-led@125 {
		label = "pixel_293";
		reg = <0x125>;
		color = <LED_COLOR_ID_RGB>;
		function = LED_FUNCTION_STATUS;
	};

	multi-led@126 {
		label = "pixel_294";
		reg = <0x126>;
		color = <LED_COLOR_ID_RGB>;
		function = LED_FUNCTION_STATUS;
	};

	multi-led@127 {
		label = "pixel_295";
		reg = <0x127>;
		color = <LED_COLOR_ID_RGB>;
		function = LED_FUNCTION_STATUS;
	};

	multi-led@128 {
		label = "pixel_296";
		reg = <0x128>;
		color = <LED_COLOR_ID_RGB>;
		function = LED_FUNCTION_STATUS;
	};

	multi-led@129 {
		label = "pixel_297";
		reg = <0x129>;
		color = <LED_COLOR_ID_RGB>;
		function = LED_FUNCTION_STATUS;
	};

	multi-led@12A {
		label = "pixel_298";
		reg = <0x12A>;
		color = <LED_COLOR_ID_RGB>;
		function = LED_FUNCTION_STATUS;
	};

	multi-led@12B {
		label = "pixel_299";
		reg = <0x12B>;
		color = <LED_COLOR_ID_RGB>;
		function = LED_FUNCTION_STATUS;
	};

	multi-led@12C {
		label = "pixel_300";
		reg = <0x12C>;
		color = <LED_COLOR_ID_RGB>;
		function = LED_FUNCTION_STATUS;
	};
};